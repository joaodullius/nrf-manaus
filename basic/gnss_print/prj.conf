## prj.conf
```kconfig
# Habilita suporte a UART
CONFIG_SERIAL=y
```

## boards/nrf52840dk_nrf52840.overlay
```dts
// To get started, press Ctrl+Space to bring up the completion menu and view the available nodes.

// You can also use the buttons in the sidebar to perform actions on nodes.
// Actions currently available include:

// * Enabling / disabling the node
// * Adding the bus to a bus
// * Removing the node
// * Connecting ADC channels

// For more help, browse the DeviceTree documentation at https://docs.zephyrproject.org/latest/guides/dts/index.html
// You can also visit the nRF DeviceTree extension documentation at https://docs.nordicsemi.com/bundle/nrf-connect-vscode/page/guides/ncs_configure_app.html#devicetree-support-in-the-extension
&uart1 {
    status = "okay";
    current-speed = <38400>;
};
```

## src/main.c
```c
#include <zephyr/kernel.h>
#include <zephyr/device.h>
#include <zephyr/drivers/uart.h>

#define UART_NODE DT_NODELABEL(arduino_serial)

int main(void) {

    unsigned char recv_char;

    const struct device *uart = DEVICE_DT_GET(UART_NODE);
    if (uart == NULL || !device_is_ready(uart)) {
        printk("Could not open UART");
        return 0;
    }

    printk("Recebendo dados do MAX-M10...\n");

    while(1) {
		while(uart_poll_in(uart, &recv_char) < 0){
			k_yield();
		}
		printk("%c", recv_char);
		k_yield();
	}

}
```
