## ble_sensors/common/src/battery_level/Kconfig.battery_level
```kconfig
#
# Copyright (c) 2024 Nordic Semiconductor
#
# SPDX-License-Identifier: LicenseRef-Nordic-5-Clause
#

menu "Battery Level Service"

menuconfig BATTERY_LEVEL
    bool "Enable Battery Level"
    default n
    select BT_BAS
    select ADC
    depends on BT_PERIPHERAL
    help
      Enable or disable the Baterry Level service.

module = BATTERY_LEVEL
module-str = BATTERY_LEVEL
source "subsys/logging/Kconfig.template.log_config"

endmenu # Sensor BLE Service
```

## ble_sensors/common/src/sensor_ble/Kconfig.sensor_ble
```kconfig
#
# Copyright (c) 2024 Nordic Semiconductor
#
# SPDX-License-Identifier: LicenseRef-Nordic-5-Clause
#

menu "Sensor BLE"

module = SENSOR_BLE
module-str = SENSOR_BLE
source "subsys/logging/Kconfig.template.log_config"

endmenu # Sensor BLE
```

## ble_sensors/common/src/sensor_ble_service/Kconfig.sensor_ble_service
```kconfig
#
# Copyright (c) 2024 Nordic Semiconductor
#
# SPDX-License-Identifier: LicenseRef-Nordic-5-Clause
#

menu "Sensor BLE Service"

menuconfig SENSOR_BLE_SERVICE
    bool "Enable Sensor BLE Service"
    default n
    depends on BT_PERIPHERAL
    help
      Enable or disable the Sensor BLE service.

module = SENSOR_BLE_SERVICE
module-str = SENSOR_BLE_SERVICE
source "subsys/logging/Kconfig.template.log_config"

endmenu # Sensor BLE Service
```

## ble_sensors/common/src/sensor_common/Kconfig.sensor_common
```kconfig
#
# Copyright (c) 2024 Nordic Semiconductor
#
# SPDX-License-Identifier: LicenseRef-Nordic-5-Clause
#

menu "Sensor Common"

module = SENSOR_COMMON
module-str = SENSOR_COMMON
source "subsys/logging/Kconfig.template.log_config"

endmenu # Sensor Common
```

## ble_sensors/concentrator/src/modules/accept_list_service/Kconfig.accept_list_service
```kconfig
#
# Copyright (c) 2024 Nordic Semiconductor
#
# SPDX-License-Identifier: LicenseRef-Nordic-5-Clause
#

menu "Accept List Service"

menuconfig ACCEPT_LIST
  bool "Enable Accept List Service"
  default n
  select BT_FILTER_ACCEPT_LIST
  help
    Enable or disable the Accept List service.

module = ACCEPT_LIST
module-str = ACCEPT_LIST
source "subsys/logging/Kconfig.template.log_config"

endmenu # Accept List Service
```

## ble_sensors/concentrator/src/modules/concentrator_periph/Kconfig.concentrator_periph
```kconfig
#
# Copyright (c) 2024 Nordic Semiconductor
#
# SPDX-License-Identifier: LicenseRef-Nordic-5-Clause
#

menu "Concentrator Peripheral"

module = CONCENTRATOR_PERIPH
module-str = CONCENTRATOR_PERIPH
source "subsys/logging/Kconfig.template.log_config"

endmenu # Concentrator Peripheral
```

## ble_sensors/concentrator/src/modules/sensor_scanner/Kconfig.sensor_scanner
```kconfig
#
# Copyright (c) 2024 Nordic Semiconductor
#
# SPDX-License-Identifier: LicenseRef-Nordic-5-Clause
#

menu "Sensor Scanner"

menuconfig SENSOR_SCANNER_DUPLICATE_FILTER
  bool "Enable Sensor Scanner Duplicate Filter"
  default n
  help
    Enable or disable the Sensor Scanner Duplicate Filter

module = SENSOR_SCANNER
module-str = SENSOR_SCANNER
source "subsys/logging/Kconfig.template.log_config"

endmenu # Sensor Scanner
```

## ble_sensors/concentrator/src/modules/worker_shadow_service/Kconfig.worker_shadow_service
```kconfig
#
# Copyright (c) 2024 Nordic Semiconductor
#
# SPDX-License-Identifier: LicenseRef-Nordic-5-Clause
#
menu "Worker Shadow Service"

module = WORKER_SHADOW_SERVICE
module-str = WORKER_SHADOW_SERVICE
source "subsys/logging/Kconfig.template.log_config"

endmenu # Worker Shadow Service
```

## ble_sensors/gateway/src/modules/bt_simple_service_client/Kconfig.bt_simple_service_client
```kconfig
#
# Copyright (c) 2024 Nordic Semiconductor
#
# SPDX-License-Identifier: LicenseRef-Nordic-5-Clause
#

menu "BT Simple Service Client"

module = BT_SIMPLE_SERVICE_CLIENT
module-str = BT_SIMPLE_SERVICE_CLIENT
source "subsys/logging/Kconfig.template.log_config"

endmenu # BT Simple Service Client
```

## ble_sensors/gateway/src/modules/gateway_ble/Kconfig.gateway_ble
```kconfig
#
# Copyright (c) 2024 Nordic Semiconductor
#
# SPDX-License-Identifier: LicenseRef-Nordic-5-Clause
#

menu "Gateway BLE"

module = GATEWAY_BLE
module-str = Gateway_BLE
source "subsys/logging/Kconfig.template.log_config"

endmenu # Gateway BLE
```

## ble_sensors/gateway/src/modules/gateway_lte/Kconfig.gateway_lte
```kconfig
#
# Copyright (c) 2024 Nordic Semiconductor
#
# SPDX-License-Identifier: LicenseRef-Nordic-5-Clause
#

menu "Gateway BLE"

module = GATEWAY_LTE
module-str = Gateway_LTE
source "subsys/logging/Kconfig.template.log_config"

endmenu # Gateway BLE
```

## ble_sensors/sensor_gnss_adv/src/modules/parser_gnss/Kconfig.parser_gnss
```kconfig
#
# Copyright (c) 2024 Nordic Semiconductor
#
# SPDX-License-Identifier: LicenseRef-Nordic-5-Clause
#

menu "Parser GNSS"

module = PARSER_GNSS
module-str = PARSER_GNSS
source "subsys/logging/Kconfig.template.log_config"

endmenu # Parser GNSS
```
